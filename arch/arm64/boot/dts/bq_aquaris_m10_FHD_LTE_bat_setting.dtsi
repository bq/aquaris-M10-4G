/*************************
 * Customized Battery Setting dtsi file
*************************/
&bat_comm {
	/* cust_charging.h */

	/* Charging Current Setting */
	usb_charger_current = <50000>;	/* Unit: 0.01 mA */
	ac_charger_input_current = <205600>; /* Unit: 0.01 mA */
	ac_charger_current = <205600>;	/* Unit: 0.01 mA */
	non_std_ac_charger_current = <205600>;	/* Unit: 0.01 mA */
	charging_host_charger_current = <65000>;	/* Unit: 0.01 mA */

	/* charger error check */
	bat_low_temp_protect_enable = <1>;
	v_charger_enable = <0>;	/* 1:on , 0:off */
	v_charger_max = <6000>;	/* unit: mV */
	v_charger_min = <4400>;
	max_charge_temperature = <45>;
	min_charge_temperature = <(-5)>;
	max_charge_temperature_minus_x_degree = <41>;
	min_charge_temperature_plus_x_degree = <6>;

	/*  Tracking TIME */
	onehundred_percent_tracking_time = <10>;	/* Unit: second */
	npercent_tracking_time = <20>;	/* Unit: second */
	sync_to_real_tracking_time = <60>;	/* Unit: second */
	v_0percent_tracking = <3450>;	/* Unit: mV */

	/* High battery support */
	high_battery_voltage_support = <1>;
};

&bat_meter {
	/* cust_battery_meter.h */
	/* ADC resistor  */
	r_bat_sense = <4>;
	r_i_sense = <4>;
	r_charger_1 = <330>;
	r_charger_2 = <39>;
	temperature_t0 = <110>;
	temperature_t1 = <0>;
	temperature_t2 = <25>;
	temperature_t3 = <50>;
	temperature_t = <255>;	/* this should be fixed, never change the value */
	fg_meter_resistance = <0>;

	/* Qmax for 0mA */
	q_max_pos_50 = <7149>;
	q_max_pos_25 = <7149>;
	q_max_pos_0 = <7149>;
	q_max_neg_10 = <7149>;
	/* Qmax for 600mA, said high current */
	q_max_pos_50_h_current = <7149>;
	q_max_pos_25_h_current = <7149>;
	q_max_pos_0_h_current = <7149>;
	q_max_neg_10_h_current = <7149>;
	/* Discharge percentage, 1: D5, 0: D2 */
	oam_d5 = <0>;

	change_tracking_point = <1>;
	/* SW OCV tracking setting */
	cust_tracking_point = <0>;
	cust_r_sense = <68>;
	cust_hw_cc = <0>;
	aging_tuning_value = <103>;
	cust_r_fg_offset = <0>;
	ocv_board_compesate = <0>;
	r_fg_board_base = <1000>;
	r_fg_board_slope = <1000>;
	car_tune_value = <100>;
	system_off_voltage = <3450>;	/* Unit: mV */

	/* HW Fuel gague  */
	current_detect_r_fg = <10>;	/* Unit: mA */
	minerroroffset = <1000>;
	fg_vbat_average_size = <18>;
	r_fg_value = <10>;	/* Unit: mOhm */

	/* FG 2.0 */
	difference_hwocv_rtc = <30>;
	difference_hwocv_swocv = <10>;
	difference_swocv_rtc = <10>;
	max_swocv = <3>;

	difference_voltage_update = <20>;
	aging1_load_soc = <70>;
	aging1_update_soc = <30>;
	batterypseudo100 = <95>;
	batterypseudo1 = <4>;

	q_max_by_sys = <1>; /*Qmax varient by system drop voltage */
	q_max_sys_voltage = <3300>;
	shutdown_gauge0 = <1>;
	shutdown_gauge1_xmins = <1>;
	shutdown_gauge1_mins = <60>;

	shutdown_system_voltage = <3400>;
	charge_tracking_time = <60>;
	discharge_tracking_time = <10>;

	recharge_tolerance = <10>;

	/* FG 1.0 */
	cust_poweron_delta_capacity_tolrance = <80>;
	cust_poweron_low_capacity_tolrance = <5>;
	cust_poweron_max_vbat_tolrance = <70>;
	cust_poweron_delta_vbat_tolrance = <60>;
	cust_poweron_delta_hw_sw_ocv_capacity_tolrance = <10>;

	/* Fixed battery temperature */
	fixed_tbat_25 = <0>;
	/* Battery remove detecton */
	vbat_remove_detection = <0>;
	/* Dynamic change wake up period of battery thread when suspend */
	vbat_normal_wakeup = <3600>;	/* Unit: mV */
	vbat_low_power_wakeup = <3500>;	/* Unit: mV */
	normal_wakeup_period = <5400>;	/* Unit: second */
	low_power_wakeup_period = <300>;	/* Unit: second */
	close_poweroff_wakeup_period = <30>;	/* Unit: second */

	rbat_pull_up_r = <16900>;
	rbat_pull_up_volt = <1800>;

	batt_temperature_table_num = <17>;
	batt_temperature_table = <
		(-20) 68237
		(-15) 53650
		(-10) 42506
		(-5) 33892
		0 27219
		5 22021
		10 17926
		15 14674
		20 12081
		25 10000
		30 8315
		35 6948
		40 5834
		45 4917
		50 4161
		55 3535
		60 3014
	>;

	battery_profile_t0_num = <75>;
	battery_profile_t0 = <
				0   4310
				1   4267
				3   4248
				4   4232
				5   4226
				7   4211
				8   4204
				10  4195
				11  4184
				12  4169
				14  4154
				15  4149
				16  4145
				18  4120
				19  4115
				20  4101
				22  4098
				23  4082
				24  4072
				26  4062
				27  4046
				29  4037
				30  4014
				31  4005
				33  3989
				34  3973
				35  3964
				37  3953
				38  3941
				39  3937
				41  3922
				42  3918
				44  3906
				45  3895
				46  3890
				48  3879
				49  3872
				50  3865
				52  3859
				53  3853
				54  3848
				56  3843
				57  3838
				58  3830
				60  3819
				61  3815
				63  3813
				64  3810
				65  3809
				67  3804
				68  3803
				69  3800
				71  3789
				72  3788
				73  3784
				75  3779
				76  3775
				78  3770
				79  3766
				80  3752
				82  3747
				83  3740
				84  3733
				86  3727
				87  3719
				88  3708
				90  3704
				91  3692
				92  3690
				94  3688
				95  3679
				97  3652
				98  3605
				99  3553
				100 3500
	>;

	battery_profile_t1_num = <75>;
	battery_profile_t1 = <
				0   4310
				1   4267
				3   4248
				4   4232
				5   4226
				7   4211
				8   4204
				10  4195
				11  4184
				12  4169
				14  4154
				15  4149
				16  4145
				18  4120
				19  4115
				20  4101
				22  4098
				23  4082
				24  4072
				26  4062
				27  4046
				29  4037
				30  4014
				31  4005
				33  3989
				34  3973
				35  3964
				37  3953
				38  3941
				39  3937
				41  3922
				42  3918
				44  3906
				45  3895
				46  3890
				48  3879
				49  3872
				50  3865
				52  3859
				53  3853
				54  3848
				56  3843
				57  3838
				58  3830
				60  3819
				61  3815
				63  3813
				64  3810
				65  3809
				67  3804
				68  3803
				69  3800
				71  3789
				72  3788
				73  3784
				75  3779
				76  3775
				78  3770
				79  3766
				80  3752
				82  3747
				83  3740
				84  3733
				86  3727
				87  3719
				88  3708
				90  3704
				91  3692
				92  3690
				94  3688
				95  3679
				97  3652
				98  3605
				99  3553
				100 3500
	>;

	battery_profile_t2_num = <75>;
	battery_profile_t2 = <
				0   4310
				1   4267
				3   4248
				4   4232
				5   4226
				7   4211
				8   4204
				10  4195
				11  4184
				12  4169
				14  4154
				15  4149
				16  4145
				18  4120
				19  4115
				20  4101
				22  4098
				23  4082
				24  4072
				26  4062
				27  4046
				29  4037
				30  4014
				31  4005
				33  3989
				34  3973
				35  3964
				37  3953
				38  3941
				39  3937
				41  3922
				42  3918
				44  3906
				45  3895
				46  3890
				48  3879
				49  3872
				50  3865
				52  3859
				53  3853
				54  3848
				56  3843
				57  3838
				58  3830
				60  3819
				61  3815
				63  3813
				64  3810
				65  3809
				67  3804
				68  3803
				69  3800
				71  3789
				72  3788
				73  3784
				75  3779
				76  3775
				78  3770
				79  3766
				80  3752
				82  3747
				83  3740
				84  3733
				86  3727
				87  3719
				88  3708
				90  3704
				91  3692
				92  3690
				94  3688
				95  3679
				97  3652
				98  3605
				99  3553
				100 3500
	>;

	battery_profile_t3_num = <75>;
	battery_profile_t3 = <
				0   4310
				1   4267
				3   4248
				4   4232
				5   4226
				7   4211
				8   4204
				10  4195
				11  4184
				12  4169
				14  4154
				15  4149
				16  4145
				18  4120
				19  4115
				20  4101
				22  4098
				23  4082
				24  4072
				26  4062
				27  4046
				29  4037
				30  4014
				31  4005
				33  3989
				34  3973
				35  3964
				37  3953
				38  3941
				39  3937
				41  3922
				42  3918
				44  3906
				45  3895
				46  3890
				48  3879
				49  3872
				50  3865
				52  3859
				53  3853
				54  3848
				56  3843
				57  3838
				58  3830
				60  3819
				61  3815
				63  3813
				64  3810
				65  3809
				67  3804
				68  3803
				69  3800
				71  3789
				72  3788
				73  3784
				75  3779
				76  3775
				78  3770
				79  3766
				80  3752
				82  3747
				83  3740
				84  3733
				86  3727
				87  3719
				88  3708
				90  3704
				91  3692
				92  3690
				94  3688
				95  3679
				97  3652
				98  3605
				99  3553
				100 3500
	>;

	r_profile_t0_num = <75>;
	r_profile_t0 = <
				147  4310
				147  4267
				147  4248
				148  4232
				148  4226
				152  4211
				150  4204
				150  4195
				152  4184
				152  4169
				152  4154
				152  4149
				155  4145
				155  4120
				157  4115
				157  4101
				160  4098
				167  4082
				167  4072
				162  4062
				160  4046
				162  4037
				163  4014
				167  4005
				172  3989
				173  3973
				173  3964
				172  3953
				170  3941
				167  3937
				160  3922
				155  3918
				152  3906
				148  3895
				148  3890
				148  3879
				148  3872
				148  3865
				148  3859
				148  3853
				150  3848
				150  3843
				150  3838
				152  3830
				152  3819
				152  3815
				152  3813
				155  3810
				153  3809
				155  3804
				155  3803
				155  3800
				155  3789
				155  3788
				152  3784
				152  3779
				152  3775
				150  3770
				150  3766
				150  3752
				152  3747
				152  3740
				152  3733
				153  3727
				153  3719
				152  3708
				152  3704
				153  3692
				157  3690
				160  3688
				163  3679
				160  3652
				163  3605
				183  3553
				200  3500
	>;

	r_profile_t1_num = <75>;
	r_profile_t1 = <
				147  4310
				147  4267
				147  4248
				148  4232
				148  4226
				152  4211
				150  4204
				150  4195
				152  4184
				152  4169
				152  4154
				152  4149
				155  4145
				155  4120
				157  4115
				157  4101
				160  4098
				167  4082
				167  4072
				162  4062
				160  4046
				162  4037
				163  4014
				167  4005
				172  3989
				173  3973
				173  3964
				172  3953
				170  3941
				167  3937
				160  3922
				155  3918
				152  3906
				148  3895
				148  3890
				148  3879
				148  3872
				148  3865
				148  3859
				148  3853
				150  3848
				150  3843
				150  3838
				152  3830
				152  3819
				152  3815
				152  3813
				155  3810
				153  3809
				155  3804
				155  3803
				155  3800
				155  3789
				155  3788
				152  3784
				152  3779
				152  3775
				150  3770
				150  3766
				150  3752
				152  3747
				152  3740
				152  3733
				153  3727
				153  3719
				152  3708
				152  3704
				153  3692
				157  3690
				160  3688
				163  3679
				160  3652
				163  3605
				183  3553
				200  3500
	>;

	r_profile_t2_num = <75>;
	r_profile_t2 = <
				147  4310
				147  4267
				147  4248
				148  4232
				148  4226
				152  4211
				150  4204
				150  4195
				152  4184
				152  4169
				152  4154
				152  4149
				155  4145
				155  4120
				157  4115
				157  4101
				160  4098
				167  4082
				167  4072
				162  4062
				160  4046
				162  4037
				163  4014
				167  4005
				172  3989
				173  3973
				173  3964
				172  3953
				170  3941
				167  3937
				160  3922
				155  3918
				152  3906
				148  3895
				148  3890
				148  3879
				148  3872
				148  3865
				148  3859
				148  3853
				150  3848
				150  3843
				150  3838
				152  3830
				152  3819
				152  3815
				152  3813
				155  3810
				153  3809
				155  3804
				155  3803
				155  3800
				155  3789
				155  3788
				152  3784
				152  3779
				152  3775
				150  3770
				150  3766
				150  3752
				152  3747
				152  3740
				152  3733
				153  3727
				153  3719
				152  3708
				152  3704
				153  3692
				157  3690
				160  3688
				163  3679
				160  3652
				163  3605
				183  3553
				200  3500
	>;

	r_profile_t3_num = <75>;
	r_profile_t3 = <
				147  4310
				147  4267
				147  4248
				148  4232
				148  4226
				152  4211
				150  4204
				150  4195
				152  4184
				152  4169
				152  4154
				152  4149
				155  4145
				155  4120
				157  4115
				157  4101
				160  4098
				167  4082
				167  4072
				162  4062
				160  4046
				162  4037
				163  4014
				167  4005
				172  3989
				173  3973
				173  3964
				172  3953
				170  3941
				167  3937
				160  3922
				155  3918
				152  3906
				148  3895
				148  3890
				148  3879
				148  3872
				148  3865
				148  3859
				148  3853
				150  3848
				150  3843
				150  3838
				152  3830
				152  3819
				152  3815
				152  3813
				155  3810
				153  3809
				155  3804
				155  3803
				155  3800
				155  3789
				155  3788
				152  3784
				152  3779
				152  3775
				150  3770
				150  3766
				150  3752
				152  3747
				152  3740
				152  3733
				153  3727
				153  3719
				152  3708
				152  3704
				153  3692
				157  3690
				160  3688
				163  3679
				160  3652
				163  3605
				183  3553
				200  3500
	>;
};
